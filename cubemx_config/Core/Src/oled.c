#include "oled.h"

/*
 * 固定绑定 I2C2
 * 如果将来改成 I2C1，只需要把 hi2c2 改成 hi2c1
 */
#define OLED_I2C_HANDLER    hi2c2

/* 显存缓冲区: 8页 * 128列 */
static uint8_t OLED_GRAM[OLED_PAGES][OLED_WIDTH];

/* ========================= 6x8 ASCII 字模（仅第一版常用） =========================
 * 每个字符6字节，纵向8点
 * 范围: ASCII 32~126
 */
static const uint8_t OLED_F6x8[][6] =
{
    {0x00, 0x00, 0x00, 0x00, 0x00, 0x00}, /* ' ' */
    {0x00, 0x00, 0x5F, 0x00, 0x00, 0x00}, /* '!' */
    {0x00, 0x07, 0x00, 0x07, 0x00, 0x00}, /* '"' */
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    {0x08, 0x04, 0x08, 0x10, 0x08, 0x00} /* '~' */
};

/* ========================= 内部底层函数 ========================= */

static void OLED_WriteCmd(uint8_t cmd)
{
    uint8_t buf[2];
    buf[0] = 0x00;
    buf[1] = cmd;
    HAL_I2C_Master_Transmit(&OLED_I2C_HANDLER, OLED_I2C_ADDR, buf, 2, HAL_MAX_DELAY);
}

static void OLED_WriteData(uint8_t* data, uint16_t size)
{
    uint8_t buf[129];
    uint16_t i;

    if (size > 128) return;

    buf[0] = 0x40;
    for (i = 0; i < size; i++)
    {
        buf[i + 1] = data[i];
    }

    HAL_I2C_Master_Transmit(&OLED_I2C_HANDLER, OLED_I2C_ADDR, buf, size + 1, HAL_MAX_DELAY);
}

static void OLED_SetCursor(uint8_t page, uint8_t column)
{
    OLED_WriteCmd(0xB0 + page);
    OLED_WriteCmd(0x10 + ((column & 0xF0) >> 4));
    OLED_WriteCmd(0x00 + (column & 0x0F));
}

/* ========================= 对外接口函数 ========================= */

void OLED_Init(void)
{
    HAL_Delay(100);

    OLED_WriteCmd(0xAE); /* display off */

    OLED_WriteCmd(0x20); /* Set Memory Addressing Mode */
    OLED_WriteCmd(0x10); /* Page Addressing Mode */

    OLED_WriteCmd(0xB0); /* Page Start Address */
    OLED_WriteCmd(0xC8); /* COM Output Scan Direction */
    OLED_WriteCmd(0x00); /* low column address */
    OLED_WriteCmd(0x10); /* high column address */
    OLED_WriteCmd(0x40); /* start line address */

    OLED_WriteCmd(0x81); /* contrast control */
    OLED_WriteCmd(0x7F);

    OLED_WriteCmd(0xA1); /* segment remap */
    OLED_WriteCmd(0xA6); /* normal display */

    OLED_WriteCmd(0xA8); /* multiplex ratio */
    OLED_WriteCmd(0x3F); /* 1/64 duty */

    OLED_WriteCmd(0xA4); /* display follows RAM content */
    OLED_WriteCmd(0xD3); /* display offset */
    OLED_WriteCmd(0x00);

    OLED_WriteCmd(0xD5); /* display clock divide ratio */
    OLED_WriteCmd(0xF0);

    OLED_WriteCmd(0xD9); /* pre-charge period */
    OLED_WriteCmd(0x22);

    OLED_WriteCmd(0xDA); /* COM pins hardware config */
    OLED_WriteCmd(0x12);

    OLED_WriteCmd(0xDB); /* VCOMH deselect level */
    OLED_WriteCmd(0x20);

    OLED_WriteCmd(0x8D); /* charge pump */
    OLED_WriteCmd(0x14);

    OLED_WriteCmd(0xAF); /* display ON */

    OLED_Clear();
    OLED_Refresh();
}

void OLED_Clear(void)
{
    uint8_t page, col;

    for (page = 0; page < OLED_PAGES; page++)
    {
        for (col = 0; col < OLED_WIDTH; col++)
        {
            OLED_GRAM[page][col] = 0x00;
        }
    }
}

void OLED_Fill(uint8_t data)
{
    uint8_t page, col;

    for (page = 0; page < OLED_PAGES; page++)
    {
        for (col = 0; col < OLED_WIDTH; col++)
        {
            OLED_GRAM[page][col] = data;
        }
    }
}

void OLED_Refresh(void)
{
    uint8_t page;

    for (page = 0; page < OLED_PAGES; page++)
    {
        OLED_SetCursor(page, 0);
        OLED_WriteData(OLED_GRAM[page], OLED_WIDTH);
    }
}

void OLED_DrawPoint(uint8_t x, uint8_t y, uint8_t color)
{
    uint8_t page;
    uint8_t bit;

    if (x >= OLED_WIDTH || y >= OLED_HEIGHT)
    {
        return;
    }

    page = y / 8;
    bit  = y % 8;

    if (color == OLED_COLOR_WHITE)
    {
        OLED_GRAM[page][x] |= (1 << bit);
    }
    else
    {
        OLED_GRAM[page][x] &= ~(1 << bit);
    }
}

void OLED_ShowChar(uint8_t x, uint8_t y, char chr)
{
    uint8_t i;
    uint8_t c;
    uint8_t line;

    if (x > (OLED_WIDTH - 6) || y > (OLED_HEIGHT - 8))
    {
        return;
    }

    if (chr < ' ' || chr > '~')
    {
        chr = '?';
    }

    c = chr - ' ';

    for (i = 0; i < 6; i++)
    {
        line = OLED_F6x8[c][i];

        /* 每一列8个点 */
        for (uint8_t j = 0; j < 8; j++)
        {
            if (line & (1 << j))
            {
                OLED_DrawPoint(x + i, y + j, OLED_COLOR_WHITE);
            }
            else
            {
                OLED_DrawPoint(x + i, y + j, OLED_COLOR_BLACK);
            }
        }
    }
}

void OLED_ShowString(uint8_t x, uint8_t y, char* str)
{
    while (*str != '\0')
    {
        OLED_ShowChar(x, y, *str);
        x += 6;

        /* 到边界就换行 */
        if (x > (OLED_WIDTH - 6))
        {
            x = 0;
            y += 8;
        }

        /* 超过屏幕高度则停止 */
        if (y > (OLED_HEIGHT - 8))
        {
            break;
        }

        str++;
    }
}
